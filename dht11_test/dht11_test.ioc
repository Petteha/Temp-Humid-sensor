# file: dht11_test.ioc
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Mcu.Family=STM32G4
Mcu.Name=STM32G491R(C-E)Tx
Mcu.Package=LQFP64
NUCLEO-G491RE.BUTTON=1
NUCLEO-G491RE.LD2=true
NUCLEO-G491RE.VCP=true
NVIC.EXTI15_10_IRQn=true\:0\:0\:false\:false\:true\:false\:true\:true
NVIC.PriorityGroup=NVIC_PRIORITYGROUP_4
PA13.GPIO_Label=T_SWDIO
PA13.Signal=SYS_JTMS-SWDIO
PA14.GPIO_Label=T_SWCLK
PA14.Signal=SYS_JTCK-SWCLK
PA2.Signal=LPUART1_TX
PA3.Signal=LPUART1_RX
PB3.GPIO_Label=T_SWO
PB3.Signal=SYS_JTDO-SWO
PC10.GPIO_Label=dht_data
PC10.Signal=GPIO_Input
PC14-OSC32_IN.GPIO_Label=RCC_OSC32_IN
PC14-OSC32_IN.Signal=RCC_OSC32_IN
PC15-OSC32_OUT.GPIO_Label=RCC_OSC32_OUT
PC15-OSC32_OUT.Signal=RCC_OSC32_OUT
PF0-OSC_IN.GPIO_Label=RCC_OSC_IN
PF0-OSC_IN.Signal=RCC_OSC_IN
PF1-OSC_OUT.GPIO_Label=RCC_OSC_OUT
PF1-OSC_OUT.Signal=RCC_OSC_OUT
ProjectManager.HeapSize=0x200
ProjectManager.StackSize=0x400
ProjectManager.TargetToolchain=STM32CubeIDE
RCC.ADC12Freq_Value=170000000
RCC.ADC345Freq_Value=170000000
RCC.AHBFreq_Value=170000000
RCC.APB1Freq_Value=170000000
RCC.APB1TimFreq_Value=170000000
RCC.APB2Freq_Value=170000000
RCC.APB2TimFreq_Value=170000000
RCC.CortexFreq_Value=170000000
RCC.EXTERNAL_CLOCK_VALUE=12288000
RCC.HCLKFreq_Value=170000000
RCC.HSE_VALUE=24000000
RCC.HSI48_VALUE=48000000
RCC.HSI_VALUE=16000000
RCC.LSE_VALUE=32768
RCC.PLLM=RCC_PLLM_DIV4
RCC.PLLN=85
RCC.RTCClockSelection=RCC_RTCCLKSOURCE_LSE
RCC.SYSCLKFreq_VALUE=170000000
RCC.SYSCLKSource=RCC_SYSCLKSOURCE_PLLCLK
RCC.USBFreq_Value=48000000
RCC.VCOOutputFreq_Value=340000000
TIM6.Prescaler=169
VP_NUCLEO-G491RE_VS_BSP_COMMON.Mode=COMMON
VP_SYS_VS_DBSignals.Mode=DisableDeadBatterySignals
VP_TIM6_VS_ClockSourceINT.Mode=Enable_Timer
board=NUCLEO-G491RE

// file: Core/Src/main.c
/* USER CODE BEGIN Header */
/**
  ******************************************************************************
  * @file           : main.c
  * @brief          : Main program body
  ******************************************************************************
  * @attention
  *
  * Copyright (c) 2026 STMicroelectronics.
  * All rights reserved.
  *
  * This software is licensed under terms that can be found in the LICENSE file
  * in the root directory of this software component.
  * If no LICENSE file comes with this software, it is provided AS-IS.
  *
  ******************************************************************************
  */
/* USER CODE END Header */
#include "main.h"
#include <stdbool.h>

COM_InitTypeDef BspCOMInit;
TIM_HandleTypeDef htim6;

void SystemClock_Config(void);
static void MX_GPIO_Init(void);
static void MX_TIM6_Init(void);

/* USER CODE BEGIN 0 */

void DHT_SetOutput();
void DHT_SetInput();
void DHT_ReadData(uint8_t *data);
uint8_t DHT_ReadBit();
void DHT_Transaction();
bool DHT_CheckInit();
bool DHT_CheckHighLow(uint32_t value);
bool DHT_Checksum(uint8_t *data);

void DHT_SetOutput() {
	GPIO_InitTypeDef GPIO_InitStruct = {0};

	GPIO_InitStruct.Pin = dht_data_Pin;
	GPIO_InitStruct.Mode = GPIO_MODE_OUTPUT_PP;
	GPIO_InitStruct.Pull = GPIO_NOPULL;
	GPIO_InitStruct.Speed = GPIO_SPEED_FREQ_LOW;

	HAL_GPIO_Init(dht_data_GPIO_Port, &GPIO_InitStruct);
}

void DHT_SetInput(){
	GPIO_InitTypeDef GPIO_InitStruct = {0};

	GPIO_InitStruct.Pin = dht_data_Pin;
	GPIO_InitStruct.Mode = GPIO_MODE_INPUT;
	GPIO_InitStruct.Pull = GPIO_NOPULL;

	HAL_GPIO_Init(dht_data_GPIO_Port, &GPIO_InitStruct);
}

uint8_t DHT_ReadBit(){

	// Loop while DATA is LOW
	while ((HAL_GPIO_ReadPin(dht_data_GPIO_Port, dht_data_Pin) == GPIO_PIN_RESET))	{
	}
	//RESET when DATA turns HIGH
	_HAL_TIM_SET_COUNTER(&htim6, 0);

	//LOOP to count microseconds on HIGH
	while ((HAL_GPIO_ReadPin(dht_data_GPIO_Port, dht_data_Pin) == GPIO_PIN_SET))	{
			}

	if (_HAL_TIM_GET_COUNTER(&htim6) > 45){
		return 1;
	} else {
		return 0;
	}
}

void DHT_ReadData(uint8_t *data){

	for (int i = 0; i < 5; i++){

		// building the byte.
		uint8_t byte = 0;

		// Loop 8 times per byte of data
		for (int y = 0; y < 8; y++){
			byte = (byte << 1) | DHT_ReadBit();
		}

		// store the data in array
		data[i] = byte;
	}

}

bool DHT_CheckInit() {

	uint32_t timeout = 10000; // in milliseconds

	// The DHT11 sends a low-high-low signal before sending data for
	// Measuring the duration of these signals are done to determine whether its functioning properly

	// initialize microsecond timer and start measuring low
		HAL_TIM_Base_Start(&htim6);
		_HAL_TIM_SET_COUNTER(&htim6,0);

	uint32_t start = HAL_GetTick();
	while ((HAL_GPIO_ReadPin(dht_data_GPIO_Port, dht_data_Pin) == GPIO_PIN_RESET)
			&& ((HAL_GetTick() - start) <= timeout))	{
		}

	// Code for start measuring high
		_HAL_TIM_SET_COUNTER(&htim6,0);

	start = HAL_GetTick();
	while ((HAL_GPIO_ReadPin(dht_data_GPIO_Port, dht_data_Pin) == GPIO_PIN_SET)
			&& ((HAL_GetTick() - start) <= timeout))	{
		}
	// Measure pc10 high duration
		if (!DHT_CheckHighLow(_HAL_TIM_GET_COUNTER(&htim6))){
				return false;
			}
	// Code for start measuring low
		_HAL_TIM_SET_COUNTER(&htim6,0);

	start = HAL_GetTick();
	while ((HAL_GPIO_ReadPin(dht_data_GPIO_Port, dht_data_Pin) == GPIO_PIN_RESET)
			&& ((HAL_GetTick() - start) <= timeout))	{
		}
	// Measure pc10 low duration
		if (!DHT_CheckHighLow(_HAL_TIM_GET_COUNTER(&htim6))){
				return false;
			}

		// If all three checks pass, return true and begin reading data from DHT11
		return true;
}

bool DHT_CheckHighLow(uint32_t value){

	if(value >= 60 && value <= 100){
		return true;
	} else {
		return false;
	}
}

bool DHT_Checksum(uint8_t *data)
{
    uint8_t checksum = 0;

    for (int i = 0; i < 4; i++)
    {
        checksum = checksum + data[i];
    }

    if (checksum == data[4])
    {
        return true;
    }

    return false;
}

void DHT_Transaction(){

	// Set DHT11 as output
	DHT_SetOutput();
	//Write low
	HAL_GPIO_WritePin(dht_data_GPIO_Port, dht_data_Pin, GPIO_PIN_RESET);
	// Wait 18 milliseconds
	HAL_Delay(18);
	// Configure pc10 as input
	DHT_SetInput();
	// Read response if initialization is ok
	uint8_t *data[5];

	if(DHT_CheckInit()){
		// Return text / print on lcd display
		DHT_ReadData(data);

	} else {
		return 0;
	}

	if (DHT_Checksum(data)){
		// Start sending data to LCD?
	}

}

/* USER CODE END 0 */

int main(void)
{

  /* MCU Configuration--------------------------------------------------------*/

  /* Reset of all peripherals, Initializes the Flash interface and the Systick. */
  HAL_Init();

  /* Configure the system clock */
  SystemClock_Config();

  /* Initialize all configured peripherals */
  MX_GPIO_Init();
  MX_TIM6_Init();

  /* Initialize led */
  BSP_LED_Init(LED_GREEN);

  /* Initialize USER push-button, will be used to trigger an interrupt each time it's pressed.*/
  BSP_PB_Init(BUTTON_USER, BUTTON_MODE_EXTI);

  /* Initialize COM1 port (115200, 8 bits (7-bit data + 1 stop bit), no parity */
  BspCOMInit.BaudRate   = 115200;
  BspCOMInit.WordLength = COM_WORDLENGTH_8B;
  BspCOMInit.StopBits   = COM_STOPBITS_1;
  BspCOMInit.Parity     = COM_PARITY_NONE;
  BspCOMInit.HwFlowCtl  = COM_HWCONTROL_NONE;
  if (BSP_COM_Init(COM1, &BspCOMInit) != BSP_ERROR_NONE)
  {
    Error_Handler();
  }

  /* Infinite loop */
  while (1)
  {

    /* USER CODE BEGIN 3 */

	  HAL_Delay(1000);
  }
  /* USER CODE END 3 */
}

void SystemClock_Config(void)
{
  RCC_OscInitTypeDef RCC_OscInitStruct = {0};
  RCC_ClkInitTypeDef RCC_ClkInitStruct = {0};

  /** Configure the main internal regulator output voltage
  */
  HAL_PWREx_ControlVoltageScaling(PWR_REGULATOR_VOLTAGE_SCALE1_BOOST);

  /** Initializes the RCC Oscillators according to the specified parameters
  * in the RCC_OscInitTypeDef structure.
  */
  RCC_OscInitStruct.OscillatorType = RCC_OSCILLATORTYPE_HSI;
  RCC_OscInitStruct.HSIState = RCC_HSI_ON;
  RCC_OscInitStruct.HSICalibrationValue = RCC_HSICALIBRATION_DEFAULT;
  RCC_OscInitStruct.PLL.PLLState = RCC_PLL_ON;
  RCC_OscInitStruct.PLL.PLLSource = RCC_PLLSOURCE_HSI;
  RCC_OscInitStruct.PLL.PLLM = RCC_PLLM_DIV4;
  RCC_OscInitStruct.PLL.PLLN = 85;
  RCC_OscInitStruct.PLL.PLLP = RCC_PLLP_DIV2;
  RCC_OscInitStruct.PLL.PLLQ = RCC_PLLQ_DIV2;
  RCC_OscInitStruct.PLL.PLLR = RCC_PLLR_DIV2;
  if (HAL_RCC_OscConfig(&RCC_OscInitStruct) != HAL_OK)
  {
    Error_Handler();
  }

  /** Initializes the CPU, AHB and APB buses clocks
  */
  RCC_ClkInitStruct.ClockType = RCC_CLOCKTYPE_HCLK|RCC_CLOCKTYPE_SYSCLK
                              |RCC_CLOCKTYPE_PCLK1|RCC_CLOCKTYPE_PCLK2;
  RCC_ClkInitStruct.SYSCLKSource = RCC_SYSCLKSOURCE_PLLCLK;
  RCC_ClkInitStruct.AHBCLKDivider = RCC_SYSCLK_DIV1;
  RCC_ClkInitStruct.APB1CLKDivider = RCC_HCLK_DIV1;
  RCC_ClkInitStruct.APB2CLKDivider = RCC_HCLK_DIV1;

  if (HAL_RCC_ClockConfig(&RCC_ClkInitStruct, FLASH_LATENCY_4) != HAL_OK)
  {
    Error_Handler();
  }
}

static void MX_TIM6_Init(void)
{

  TIM_MasterConfigTypeDef sMasterConfig = {0};

  htim6.Instance = TIM6;
  htim6.Init.Prescaler = 169;
  htim6.Init.CounterMode = TIM_COUNTERMODE_UP;
  htim6.Init.Period = 65535;
  htim6.Init.AutoReloadPreload = TIM_AUTORELOAD_PRELOAD_DISABLE;
  if (HAL_TIM_Base_Init(&htim6) != HAL_OK)
  {
    Error_Handler();
  }
  sMasterConfig.MasterOutputTrigger = TIM_TRGO_RESET;
  sMasterConfig.MasterSlaveMode = TIM_MASTERSLAVEMODE_DISABLE;
  if (HAL_TIMEx_MasterConfigSynchronization(&htim6, &sMasterConfig) != HAL_OK)
  {
    Error_Handler();
  }

}

static void MX_GPIO_Init(void)
{
  GPIO_InitTypeDef GPIO_InitStruct = {0};

  /* GPIO Ports Clock Enable */
  __HAL_RCC_GPIOC_CLK_ENABLE();
  __HAL_RCC_GPIOF_CLK_ENABLE();
  __HAL_RCC_GPIOA_CLK_ENABLE();
  __HAL_RCC_GPIOB_CLK_ENABLE();

  /*Configure GPIO pin : dht_data_Pin */
  GPIO_InitStruct.Pin = dht_data_Pin;
  GPIO_InitStruct.Mode = GPIO_MODE_INPUT;
  GPIO_InitStruct.Pull = GPIO_NOPULL;
  HAL_GPIO_Init(dht_data_GPIO_Port, &GPIO_InitStruct);

}

void Error_Handler(void)
{
  __disable_irq();
  while (1)
  {
  }
}
